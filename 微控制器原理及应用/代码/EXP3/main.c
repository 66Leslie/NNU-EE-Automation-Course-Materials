#include <reg52.h>
#include <intrins.h> // 包含 _crol_ (循环左移) 函数

//========================================================================
// 函数声明
//========================================================================
void delay_ms(unsigned int ms);
void init_interrupts(void);

//========================================================================
// 全局变量
//========================================================================
unsigned char led_pattern; // 用于主循环的流水灯模式

//========================================================================
// 延时函数 (基于 11.0592MHz 晶振)
//========================================================================
void delay_ms(unsigned int ms) {
    unsigned int i, j;
    for (i = 0; i < ms; i++) {
        for (j = 0; j < 110; j++);
    }
}

//========================================================================
// 中断初始化函数
//========================================================================
void init_interrupts(void) {
    EA = 1;  // 开启总中断

    EX0 = 1; // 允许外部中断0 (INT0)
    EX1 = 1; // 允许外部中断1 (INT1)

    IT0 = 1; // 设置 INT0 为下降沿触发
    IT1 = 1; // 设置 INT1 为下降沿触发

    PX0 = 0; // 设置 INT0 为低优先级
    PX1 = 1; // 设置 INT1 为高优先级
}

//========================================================================
// 主函数 (P1口流水灯)
//========================================================================
void main(void) {
    init_interrupts(); // 初始化中断

    led_pattern = 0xfe; // 初始状态: P1.0 (L1) 亮
    P1 = led_pattern;

    // 主循环 (流水灯)
    while (1) {
        delay_ms(250);
        
        // 循环左移实现流水灯
        led_pattern = _crol_(led_pattern, 1);
        
        P1 = led_pattern;
    }
}

//========================================================================
// 外部中断0 (INT0) 服务程序 (低优先级, K1/P3.2 触发)
// 功能：奇偶灯交替闪烁10次
//========================================================================
void int0_isr() interrupt 0 {
    unsigned char i;

    EX0 = 0; // 暂时关闭INT0，防止按键抖动

    for (i = 0; i < 10; i++) {
        P1 = 0x55; // 奇数灯亮 (01010101b)
        delay_ms(200);
        
        P1 = 0xAA; // 偶数灯亮 (10101010b)
        delay_ms(200);
    }
    
    EX0 = 1; // 重新允许INT0
}

//========================================================================
// 外部中断1 (INT1) 服务程序 (高优先级, K2/P3.3 触发)
// 功能：全部LED闪烁5次
//========================================================================
void int1_isr() interrupt 2 { // INT1 中断向量号是 2
    unsigned char i;

    EX1 = 0; // 暂时关闭INT1，防止按键抖动
    
    for (i = 0; i < 5; i++) {
        P1 = 0xFF; // 全部LED亮
        delay_ms(150);
        
        P1 = 0x00; // 全部LED灭
        delay_ms(150);
    }

    EX1 = 1; // 重新允许INT1
}